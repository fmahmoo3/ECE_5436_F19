// These arguments were used when this file was generated. They will be automatically applied on subsequent loads 
// via the GUI or CLI invocations. Run CLI with '--help' for additional information on how to override these arguments.
// @cliArgs --board "/ti/boards/MSP_EXP432P401R" --product "simplelink_msp432p4_sdk@3.30.00.13"
// @versions {"data":"2019051709","timestamp":"2019051709","tool":"1.1.792","templates":"2019051709"}

var RTOS = scripting.addModule("/ti/drivers/RTOS");
var UART = scripting.addModule("/ti/drivers/UART");
var UART1 = UART.addInstance();
var PWM = scripting.addModule("/ti/drivers/PWM");
var UART2 = UART.addInstance();
var ADC = scripting.addModule("/ti/drivers/ADC");
var ADC1 = ADC.addInstance();
var ADC2 = ADC.addInstance();
var PWM1 = PWM.addInstance();
var PWM2 = PWM.addInstance();
var Timer = scripting.addModule("/ti/drivers/Timer");
var Timer1 = Timer.addInstance();
// name - Select the RTOS being used
RTOS.name = "FreeRTOS";
// Use Hardware - Select the hardware to use, or 'none' to use available header pins
UART1.$hardware = system.deviceData.board.components.XDS110UART;
// Name - The C/C++ identifier used in applications as the index parameter passed to UART runtime APIs
UART1.$name = "CONFIG_UART1";
var Power = scripting.addModule("/ti/drivers/Power");
// Name
Power.performanceLevel3.$name = "ti_drivers_power_PowerMSP432PerfLevels0";
// Name
Power.performanceLevel2.$name = "ti_drivers_power_PowerMSP432PerfLevels1";
// Name
Power.performanceLevel1.$name = "ti_drivers_power_PowerMSP432PerfLevels2";
// Name
Power.performanceLevel0.$name = "ti_drivers_power_PowerMSP432PerfLevels3";
var Board = scripting.addModule("/ti/drivers/Board");
var DriverLib = scripting.addModule("/ti/devices/DriverLib");
// Name
UART1.uart.$name = "MyUART1";
// Name - The C/C++ identifier used in applications as the index parameter passed to UART runtime APIs
UART2.$name = "CONFIG_UART_BLUETOOTH";
// Name
UART2.uart.$name = "MyUART1";
// Assign pin
UART2.uart.txPin.$assign = "boosterpack.4"; // P3.3
// Assign pin
UART2.uart.rxPin.$assign = "boosterpack.3"; // P3.2
// Name - The C/C++ identifier used in applications as the index parameter passed to ADC runtime APIs
ADC1.$name = "CONFIG_ADC_FRONT";
// Name
ADC1.adc.$name = "MyADC141";
// Use Peripheral
ADC1.adc.$assign = "ADC14";
// Assign pin
ADC1.adc.adcPin.$assign = "boosterpack.24"; // P4.0
// Name - The C/C++ identifier used in applications as the index parameter passed to ADC runtime APIs
ADC2.$name = "CONFIG_ADC_RIGHT";
// Name
ADC2.adc.$name = "MyADC141";
// Assign pin
ADC2.adc.adcPin.$assign = "boosterpack.5"; // P4.1
// Name - The C/C++ identifier used in applications as the index parameter passed to PWM runtime APIs
PWM1.$name = "CONFIG_PWM_LEFT_MOTOR";
// Name
PWM1.timer.$name = "MyTIMER_A1";
// Assign pin
PWM1.timer.pwmPin.$assign = "boosterpack.31"; // P3.7
// Name - The C/C++ identifier used in applications as the index parameter passed to PWM runtime APIs
PWM2.$name = "CONFIG_PWM_RIGHT_MOTOR";
// Name
PWM2.timer.$name = "MyTIMER_A1";
// Assign pin
PWM2.timer.pwmPin.$assign = "boosterpack.38"; // P2.4
// Name - The C/C++ identifier used in applications as the index parameter passed to Timer runtime APIs
Timer1.$name = "CONFIG_TIMER_PID";
// Name
Timer1.timer.$name = "MyTIMER_A1";
// Suggest solution
UART1.uart.$suggestSolution = "EUSCI_A0";
// Suggest solution
UART1.uart.txPin.$suggestSolution = "7";
// Suggest solution
UART1.uart.rxPin.$suggestSolution = "6";
// Suggest solution
UART2.uart.$suggestSolution = "EUSCI_A1";
// Suggest solution
ADC2.adc.$suggestSolution = "ADC14";
// Suggest solution
PWM1.timer.$suggestSolution = "Timer_A1";
// Suggest solution
PWM2.timer.$suggestSolution = "Timer_A1";
// Suggest solution
Timer1.timer.$suggestSolution = "Timer_A0";
