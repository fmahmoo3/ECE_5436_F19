// These arguments were used when this file was generated. They will be automatically applied on subsequent loads 
// via the GUI or CLI invocations. Run CLI with '--help' for additional information on how to override these arguments.
// @cliArgs --board "/ti/boards/MSP_EXP432P401R" --product "simplelink_msp432p4_sdk@3.30.00.13"
// @versions {"data":"2019051709","timestamp":"2019051709","tool":"1.1.792","templates":"2019051709"}

var RTOS = scripting.addModule("/ti/drivers/RTOS");
var GPIO = scripting.addModule("/ti/drivers/GPIO");
var GPIO1 = GPIO.addInstance();
var GPIO2 = GPIO.addInstance();
var GPIO3 = GPIO.addInstance();
var UART = scripting.addModule("/ti/drivers/UART");
var UART1 = UART.addInstance();
var Timer = scripting.addModule("/ti/drivers/Timer");
var Timer1 = Timer.addInstance();
var Timer2 = Timer.addInstance();
var Timer3 = Timer.addInstance();
var Timer4 = Timer.addInstance();
var PWM = scripting.addModule("/ti/drivers/PWM");
var PWM1 = PWM.addInstance();
var PWM2 = PWM.addInstance();
var PWM3 = PWM.addInstance();
var UART2 = UART.addInstance();
// Name
RTOS.timer0.resource.$name = "MyTIMER_A1";
var Power = scripting.addModule("/ti/drivers/Power");
// Name
Power.performanceLevel3.$name = "ti_drivers_power_PowerMSP432PerfLevels0";
// Name
Power.performanceLevel2.$name = "ti_drivers_power_PowerMSP432PerfLevels1";
// Name
Power.performanceLevel1.$name = "ti_drivers_power_PowerMSP432PerfLevels2";
// Name
Power.performanceLevel0.$name = "ti_drivers_power_PowerMSP432PerfLevels3";
var Board = scripting.addModule("/ti/drivers/Board");
var DriverLib = scripting.addModule("/ti/devices/DriverLib");
// Use Hardware - Select the hardware to use, or 'none' to use available header pins
GPIO1.$hardware = system.deviceData.board.components.S1;
// Name - The C/C++ identifier used in applications as the index parameter passed to GPIO runtime APIs
GPIO1.$name = "CONFIG_GPIO_BUTTON0";
// Use Hardware - Select the hardware to use, or 'none' to use available header pins
GPIO2.$hardware = system.deviceData.board.components.S2;
// Name - The C/C++ identifier used in applications as the index parameter passed to GPIO runtime APIs
GPIO2.$name = "CONFIG_GPIO_BUTTON1";
// Use Hardware - Select the hardware to use, or 'none' to use available header pins
GPIO3.$hardware = system.deviceData.board.components.LED1_RED;
// Name - The C/C++ identifier used in applications as the index parameter passed to GPIO runtime APIs
GPIO3.$name = "CONFIG_GPIO_LED0";
// Use Hardware - Select the hardware to use, or 'none' to use available header pins
UART1.$hardware = system.deviceData.board.components.XDS110UART;
// Name - The C/C++ identifier used in applications as the index parameter passed to UART runtime APIs
UART1.$name = "CONFIG_UART1";
// Name
UART1.uart.$name = "MyUART1";
// Name - The C/C++ identifier used in applications as the index parameter passed to Timer runtime APIs
Timer1.$name = "CONFIG_TIMER0";
// Timer Type
Timer1.timerType = "32 Bits";
// Name
Timer1.timer.$name = "MyTIMER321";
// Use Peripheral
Timer1.timer.$assign = "TIMER32_0";
// Name - The C/C++ identifier used in applications as the index parameter passed to Timer runtime APIs
Timer2.$name = "CONFIG_TIMER1";
// Timer Type
Timer2.timerType = "32 Bits";
// Name
Timer2.timer.$name = "MyTIMER321";
// Use Peripheral
Timer2.timer.$assign = "TIMER32_1";
// Name - The C/C++ identifier used in applications as the index parameter passed to Timer runtime APIs
Timer3.$name = "CONFIG_TIMER2";
// Name
Timer3.timer.$name = "MyTIMER_A1";
// Use Peripheral
Timer3.timer.$assign = "Timer_A2";
// Name - The C/C++ identifier used in applications as the index parameter passed to Timer runtime APIs
Timer4.$name = "CONFIG_TIMER3";
// Name
Timer4.timer.$name = "MyTIMER_A1";
// Use Peripheral
Timer4.timer.$assign = "Timer_A3";
// Name - The C/C++ identifier used in applications as the index parameter passed to PWM runtime APIs
PWM1.$name = "CONFIG_PWM0";
// Use Hardware - Select the hardware to use, or 'none' to use available header pins
PWM1.$hardware = system.deviceData.board.components.LED2_RED;
// Name
PWM1.timer.$name = "MyTIMER_A1";
// Assign pin
PWM1.timer.pwmPin.$assign = "P2.0.GPIO/EUSCI_A1_SPI.STE"; // pin number - 16
// Name - The C/C++ identifier used in applications as the index parameter passed to PWM runtime APIs
PWM2.$name = "CONFIG_PWM1";
// Use Hardware - Select the hardware to use, or 'none' to use available header pins
PWM2.$hardware = system.deviceData.board.components.LED2_GREEN;
// Name
PWM2.timer.$name = "MyTIMER_A1";
// Assign pin
PWM2.timer.pwmPin.$assign = "P2.1.GPIO/EUSCI_A1_SPI.CLK"; // pin number - 17
// Name - The C/C++ identifier used in applications as the index parameter passed to PWM runtime APIs
PWM3.$name = "CONFIG_PWM2";
// Use Hardware - Select the hardware to use, or 'none' to use available header pins
PWM3.$hardware = system.deviceData.board.components.LED2_BLUE;
// Name
PWM3.timer.$name = "MyTIMER_A1";
// Assign pin
PWM3.timer.pwmPin.$assign = "P2.2.GPIO/EUSCI_A1_UART.RXD/EUSCI_A1_SPI.SOMI"; // pin number - 18
// Name - The C/C++ identifier used in applications as the index parameter passed to UART runtime APIs
UART2.$name = "CONFIG_UART_BLUETOOTH";
// Name
UART2.uart.$name = "MyUART1";
// Assign pin
UART2.uart.txPin.$assign = "boosterpack.4"; // P3.3
// Assign pin
UART2.uart.rxPin.$assign = "boosterpack.3"; // P3.2
// Suggest solution
RTOS.timer0.resource.$suggestSolution = "Timer_A0";
// Suggest solution
GPIO1.gpioPin.$suggestSolution = "5";
// Suggest solution
GPIO2.gpioPin.$suggestSolution = "8";
// Suggest solution
GPIO3.gpioPin.$suggestSolution = "4";
// Suggest solution
UART1.uart.$suggestSolution = "EUSCI_A0";
// Suggest solution
UART1.uart.txPin.$suggestSolution = "7";
// Suggest solution
UART1.uart.rxPin.$suggestSolution = "6";
// Suggest solution
PWM1.timer.$suggestSolution = "Timer_A1";
// Suggest solution
PWM2.timer.$suggestSolution = "Timer_A1";
// Suggest solution
PWM3.timer.$suggestSolution = "Timer_A1";
// Suggest solution
UART2.uart.$suggestSolution = "EUSCI_A1";
